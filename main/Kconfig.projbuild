## main/Kconfig.projbuild
```kconfig
choice APP_ESP32_PROFILE
    prompt "ESP32 application profile"
    default APP_PROFILE_ESP32_BRINGUP
    help
        Waehlt genau eines der beiden ESP32-Produktionsprofile. Ohne
        explizites Release-Overlay bleibt Bring-up der sichere Default.
        Keine Option aktiviert reale Aktoren; das bleibt firmwarefest in
        main/CMakeLists.txt und include/app_config.hpp verankert
        (siehe docs/tasks/issue-74-implementation-plan.md, Abschnitt 7.2).

    config APP_PROFILE_ESP32_BRINGUP
        bool "ESP32 bring-up profile"

    config APP_PROFILE_ESP32_RELEASE
        bool "ESP32 release profile"

endchoice
```

## sdkconfig.defaults.issue31_lean
```kconfig
# Dedicated nonproductive Lean comparison profile.
CONFIG_APP_PROFILE_ESP32_BRINGUP=y
CONFIG_APP_ISSUE31_LEAN_RUNNER=y
CONFIG_XPT2046_CONVERT_ADC_TO_COORDS=n
```

## sdkconfig.defaults.issue31_lvgl
```kconfig
# Dedicated nonproductive LVGL comparison profile.
CONFIG_APP_PROFILE_ESP32_BRINGUP=y
CONFIG_APP_ISSUE31_RENDERER_COMPARISON=y
CONFIG_XPT2046_CONVERT_ADC_TO_COORDS=n
```

## spikes/issue89_wlan_onboarding/direct_protocomm/sdkconfig.defaults
```kconfig
CONFIG_IDF_TARGET="esp32"
CONFIG_ESPTOOLPY_FLASHSIZE_4MB=y
CONFIG_ESP_WIFI_ENABLED=y
CONFIG_ESP_WIFI_SOFTAP_SUPPORT=y
CONFIG_LWIP_IPV4=y
CONFIG_ESP_PROTOCOMM_SUPPORT_SECURITY_VERSION_0=y
CONFIG_HTTPD_MAX_REQ_HDR_LEN=1024
CONFIG_HTTPD_MAX_URI_LEN=256
```

## spikes/issue89_wlan_onboarding/official_network_provisioning/sdkconfig.defaults
```kconfig
CONFIG_IDF_TARGET="esp32"
CONFIG_ESPTOOLPY_FLASHSIZE_4MB=y
CONFIG_ESP_WIFI_ENABLED=y
CONFIG_ESP_WIFI_SOFTAP_SUPPORT=y
CONFIG_NETWORK_PROV_NETWORK_TYPE_WIFI=y
CONFIG_ESP_PROTOCOMM_SUPPORT_SECURITY_VERSION_0=y
CONFIG_NETWORK_PROV_WIFI_STA_ALL_CHANNEL_SCAN=y
```

## test/esp_idf_http_server_adapter_host/sdkconfig.defaults
```kconfig
CONFIG_IDF_TARGET="linux"
CONFIG_LWIP_NETIF_LOOPBACK=y
CONFIG_ESP_MAIN_TASK_STACK_SIZE=16384
```
